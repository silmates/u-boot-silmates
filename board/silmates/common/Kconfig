## board/silmates/common/Kconfig
```kconfig
config CHAIN_OF_TRUST
	depends on !FIT_SIGNATURE && NXP_ESBC
	imply CMD_BLOB
	imply CMD_HASH if ARM
	select FSL_CAAM
	select ARCH_MISC_INIT
	select SPL_BOARD_INIT if (ARM && SPL)
	select SPL_HASH if (ARM && SPL)
	select SHA_HW_ACCEL
	select SHA_PROG_HW_ACCEL
	select ENV_IS_NOWHERE
	select CMD_EXT4 if ARM
	select CMD_EXT4_WRITE if ARM
	bool
	default y

config CMD_ESBC_VALIDATE
	bool "Enable the 'esbc_validate' and 'esbc_halt' commands"
	default y if CHAIN_OF_TRUST
	help
	  This option enables two commands used for secure booting:

	    esbc_validate - validate signature using RSA verification
	    esbc_halt - put the core in spin loop (Secure Boot Only)


menuconfig SM_CFG_BLOCK
	bool "Enable Silmates config block support"
	select OF_BOARD_SETUP
	help
	  The Silmates config block stored production data on the on-module
	  flash device (NAND, NOR or eMMC). The area is normally preserved by
	  software and contains the serial number (out of which the MAC
	  address is generated) and the exact module type.

# Helper config to determine the correct default location of the cfg block
config SM_HAVE_MMC
	bool

config SM_HAVE_NAND
	bool

config SM_HAVE_NOR
	bool

config SM_HAVE_EEPROM
	bool

config SM_HAVE_EEPROM_EXTRA
	bool

if SM_CFG_BLOCK

config SM_CFG_BLOCK_IS_IN_MMC
	bool
	depends on SM_HAVE_MMC
	default n

config SM_CFG_BLOCK_IS_IN_NAND
	bool
	depends on SM_HAVE_NAND
	default n

config SM_CFG_BLOCK_IS_IN_NOR
	bool
	depends on SM_HAVE_NOR
	default n

config SM_CFG_BLOCK_IS_IN_EEPROM
	bool
	depends on SM_HAVE_EEPROM
	default y

config SM_CFG_BLOCK_DEV
	int "Silmates config block eMMC device ID"
	depends on SM_CFG_BLOCK_IS_IN_MMC

config SM_CFG_BLOCK_PART
	int "Silmates config block eMMC partition ID"
	depends on SM_CFG_BLOCK_IS_IN_MMC

config SM_CFG_BLOCK_OFFSET
	int "Silmates config block offset"
	help
	  Specify the byte offset of the Silmates config block within the flash
	  device the config block is stored on.

config SM_CFG_BLOCK_OFFSET2
	int "Silmates config block offset, second instance"
	default 0
	help
	  Specify the byte offset of the 2nd instance of the Silmates config block
	  within the flash device the config block is stored on.
	  Set to 0 on modules which have no 2nd instance.

config SM_CFG_BLOCK_2ND_ETHADDR
	bool "Set the second Ethernet address"
	help
	  For each serial number two Ethernet addresses are available for dual
	  Ethernet carrier boards. This options enables the code to set the
	  second Ethernet address as environment variable (eth1addr).

config SM_CFG_BLOCK_EXTRA
	bool "Support for additional EEPROMs (carrier board, display adapter)"
	depends on SM_HAVE_EEPROM_EXTRA
	help
	  Enables fetching auxilary config blocks from carrier board/display
	  adapter EEPROMs.

config SM_CFG_BLOCK_USB_GADGET_PID
	bool "Use config block product ID as USB product ID"
	depends on USB_GADGET_DOWNLOAD
	default n
	help
	  Use the Silmates product ID learned from the config block as USB
	  product ID. An offset of 0x4000 is added to the product ID since
	  inside the Silmates vendor ID (0x1b67) the range starting from
	  offset 0x4000 is reserved for Colibri/Apalis modules.

endif
```

## board/silmates/imx8mm_mez/Kconfig
```kconfig
if TARGET_IMX8MM_MEZ

config SYS_BOARD
	default "imx8mm_mez"

config SYS_VENDOR
	default "silmates"

config SYS_CONFIG_NAME
	default "imx8mm_mez"

config SM_CFG_BLOCK
	default y

config SM_CFG_BLOCK_EXTRA
	default n

config SM_HAVE_MMC
	default y

config SM_HAVE_EEPROM_EXTRA
	default n

config SM_CFG_BLOCK_DEV
	default "0"

config SM_CFG_BLOCK_PART
	default "1"

config SM_CFG_BLOCK_USB_GADGET_PID
	default n

config SM_CFG_BLOCK_IS_IN_MMC
	default n

config SM_CFG_BLOCK_IS_IN_NAND
	default n

config SM_CFG_BLOCK_IS_IN_NOR
	default n

config SM_CFG_BLOCK_IS_IN_EEPROM
	default y

# Silmates config block in eMMC, at the end of 1st "boot sector"
config SM_CFG_BLOCK_OFFSET
	default "-512"

config IMX_CONFIG
	default "board/silmates/imx8mm_mez/imximage-8mm.cfg"

config IMX8M_1G_MEMORY
	bool "imx8m 1GB memory size"

source "board/silmates/common/Kconfig"

endif
```
